## app/subsys/Heartbeat/Kconfig.Heartbeat
```kconfig
menu "Heartbeat Subsystem"
        config APP_HEARTBEAT_PERIOD_MS
                int "Heartbeat period (ms)"
                range 250 2000
                default 500
        config APP_HEARTBEAT_DEBUG
                bool "Enable debug messages for Heartbeat subsystem"
endmenu
```

## west.yml
```yaml
manifest:
  version: 1.0
  remotes:
    - name: zephyrproject-rtos
      url-base: https://github.com/zephyrproject-rtos
  projects:
    - name: zephyr
      remote: zephyrproject-rtos
      revision: v4.4.0-rc1
      import:
        name-allowlist:
          - cmsis_6
          - hal_stm32
          - hal_atmel
        path-prefix: deps/
```
