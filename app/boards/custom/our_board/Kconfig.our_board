## app/boards/custom/our_board/Kconfig.our_board
```kconfig
# Copyright (c) 2016 Piotr Mienkowski
# Copyright (c) 2024 Gerson Fernando Budke <nandojve@gmail.com>
# SPDX-License-Identifier: Apache-2.0

config BOARD_OUR_BOARD
	select SOC_SAMV71Q21 if BOARD_OUR_BOARD_SAMV71Q21
	select SOC_SAMV71Q21B if BOARD_OUR_BOARD_SAMV71Q21B
```

## app/boards/custom/our_board/board.yml
```yaml
board:
  name: our_board
  full_name: SAM V71(B) Xplained Ultra Custom board for zephyr course
  vendor: custom
  socs:
    - name: samv71q21
    - name: samv71q21b
```

## app/boards/custom/scratch_board/Kconfig.scratch_board
```kconfig
config BOARD_SCRATCH_BOARD
	select SOC_SAMV71Q21B if BOARD_SCRATCH_BOARD_SAMV71Q21B
```

## app/boards/custom/scratch_board/board.yml
```yaml
board:
  name: scratch_board
  full_name: SAM V71(B) Xplained Ultra Custom board from scratch for zephyr course
  vendor: custom
  socs:
    - name: samv71q21b
```

## app/drivers/sensor/led_sensor/Kconfig
```kconfig
config LED_SENSOR
        bool "LED Sensor Driver"
        depends on SENSOR
        depends on DT_HAS_LED_SENSOR_ENABLED
        help
          Enable the simple on-board LED sensor driver.
          sensor_sample_fetch turns the LED ON.
          sensor_channel_get turns the LED OFF and returns the previous state.
```
